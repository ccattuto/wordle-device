## standalone/main/Kconfig.projbuild
```kconfig
menu "Wordle Device Configuration"

    config ESP_WIFI_SSID
        string "WiFi SSID"
        default "myssid"
        help
            SSID (network name) for the device to connect to.

    config ESP_WIFI_PASSWORD
        string "WiFi Password"
        default "mypassword"
        help
            WiFi password (WPA or WPA2).

    config ESP_WIFI_HOSTNAME
        string "Network Hostname"
        default "WORDLE-DEVICE"
        help
            Hostname for connection to the network.

	config TWITTER_BEARER_TOKEN
        string "Twitter API Bearer Token"
        default "mybearertoken"
        help
            Bearer Token to access Twitter API v2.

	config TWITTER_WORDLE_TAG
        string "Tag for Wordle tweets"
        default "wordle"
        help
            Matching rule tag for Wordle tweets.
endmenu
```

## standalone/sdkconfig.defaults
```kconfig
CONFIG_IDF_TARGET="esp32c3"
CONFIG_ESPTOOLPY_FLASHSIZE_4MB=y
CONFIG_ESP_PHY_MAX_WIFI_TX_POWER=12
```
